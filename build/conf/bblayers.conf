## build/conf/bblayers.conf
```bitbake
# POKY_BBLAYERS_CONF_VERSION is increased each time build/conf/bblayers.conf
# changes incompatibly
POKY_BBLAYERS_CONF_VERSION = "2"

BBPATH = "${TOPDIR}"
BBFILES ?= ""

YOCTOROOT = "${@os.path.abspath(os.path.join("${TOPDIR}", os.pardir))}"

BBLAYERS ?= " \
  ${YOCTOROOT}/layers/meta-3dprinter \
  ${YOCTOROOT}/layers/meta-openembedded/meta-multimedia \
  ${YOCTOROOT}/layers/meta-openembedded/meta-networking \
  ${YOCTOROOT}/layers/meta-openembedded/meta-oe \
  ${YOCTOROOT}/layers/meta-openembedded/meta-perl \
  ${YOCTOROOT}/layers/meta-openembedded/meta-python \
  ${YOCTOROOT}/layers/meta-python2 \
  ${YOCTOROOT}/layers/meta-raspberrypi \
  ${YOCTOROOT}/poky/meta \
  ${YOCTOROOT}/poky/meta-poky \
  ${YOCTOROOT}/poky/meta-yocto-bsp \
"
```
